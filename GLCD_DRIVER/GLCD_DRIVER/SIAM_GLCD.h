/*
 * GLCD.h
 *
 * Created: 8/2/2016 12:29:53 PM
 *  Author: ASUS
 */ 


#ifndef GLCD_H_
#define GLCD_H_

#include <avr/pgmspace.h>

#define	Data_Port	PORTF
#define	Data_Port_1	PORTA

#define	Data_Direction		DDRF
#define	Data_Direction_1	DDRA
#define	Control_Direction	DDRE


#define  RD_Port	PORTE
#define  RD_Pin		PE2

#define  WR_Port	PORTE
#define  WR_Pin		PE3

#define  RS_Port	PORTE
#define  RS_Pin		PE4

#define  Reset_Port	PORTE
#define  Reset_Pin	PE5

#define  CS_Port	PORTE
#define  CS_Pin		PE6

char Present_page =0x01;			// Global Variable for position
char Present_Col = 0x10;


const char foot_print[] PROGMEM =
{
	0x00, 0x00, 0x00, 0x00, 0x84, 0x80, 0xC0, 0xE0, 0xE0, 0xF8, 0xDE, 0x7F, 0xEF, 0xFF, 0x7F, 0x3F,
	0x1F, 0x1F, 0x0F, 0x07, 0x03, 0x03, 0x03, 0x07, 0x07, 0x0F, 0x1F, 0x7F, 0xFF, 0xFF, 0xFF, 0xFF,
	0xFF, 0xEF, 0xFF, 0xFF, 0xFF, 0xFF, 0xFF, 0xFF, 0xFF, 0xFF, 0xFF, 0xFF, 0xFF, 0xFF, 0xFF, 0xFF,
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	0x00, 0x00, 0x00, 0x00, 0x00, 0x00, 0x00, 0x00, 0x00, 0x00, 0x00, 0x00, 0x00, 0x00, 0x00, 0x00
};

const char ra_logo[] PROGMEM =
{
0x00, 0x00, 0x00, 0x00, 0x00, 0x00, 0x00, 0x00, 0x00, 0x00, 0x00, 0x00, 0x00, 0x00, 0x00, 0x00,
0x00, 0x00, 0x80, 0x80, 0x80, 0x00, 0x80, 0x80, 0x80, 0x00, 0x80, 0x80, 0x00, 0x00, 0xC0, 0xC0,
0x00, 0xC0, 0xC0, 0xC0, 0x00, 0xC0, 0xE0, 0xE0, 0x00, 0xE0, 0xE0, 0x00, 0xE0, 0xE0, 0xE0, 0x80,
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0x01, 0x03, 0x03, 0x02, 0x03, 0x00, 0x00, 0x00, 0x03, 0x03, 0x00, 0x00, 0x03, 0x02, 0x03, 0x03

};

const char Font[] PROGMEM = 
{
	0x00, 0x00, 0x00, 0x00, 0x00, 0x00, 0x00,  // Code for char
	0x5F, 0x00, 0x00, 0x00, 0x00, 0x00, 0x00,  // Code for char !
	0x07, 0x00, 0x07, 0x00, 0x00, 0x00, 0x00,  // Code for char "
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	0x7F, 0x41, 0x7F, 0x00, 0x00, 0x00, 0x00   // Code for char 
};

void GLCD_initialize();
void GLCD_Send_Command(char command);
void GLCD_Send_Data(char data);


void GLCD_ClearScreen();
void GLCD_goto(unsigned char page,unsigned char col);

void WriteString(char string[], char length, char page, char column, bool invert, bool para);
void Write2XString(char string[], char length, char page, char column, bool invert , bool para);

void WritePattern(const char Pattern[], char height, char breadth , bool invert);

void GLCD_initialize()
{
	Data_Direction = 0x9F;
	Data_Direction_1 = 0xFF;
	Control_Direction = 0xFF;
	
	Reset_Port |= (1<< Reset_Pin);
	Reset_Port &= ~(1<< Reset_Pin);
	asm volatile ("nop");
	Reset_Port |= (1<< Reset_Pin);
	_delay_ms(10);
	
	GLCD_Send_Command(0xaf);            // display on
	GLCD_Send_Command(0x40);            // display start line=0
	GLCD_Send_Command(0xa0);            // ADC=0
	GLCD_Send_Command(0xa6);            // normal display
	GLCD_Send_Command(0xa4);            // Duisplay all point = off
	GLCD_Send_Command(0xa2);            // LCD bias = 1/9
	GLCD_Send_Command(0xc8);            // Common output mode select= reverse
	GLCD_Send_Command(0x2f);            // Power control = all on

	GLCD_Send_Command(0x25);			// set the Rab ratio to middle
	GLCD_Send_Command(0x81);            // E-Vol setting
	GLCD_Send_Command(0x20);			 // (2byte command)
		
}


void GLCD_Send_Command(char command)
{
	RS_Port &= ~(1<< RS_Pin);			//	Control	
	WR_Port |= (1<< WR_Pin);
	RD_Port |= (1<< RD_Pin);
	
	Data_Port = (command & 0x9F);
	Data_Port_1= (command & 0b00100000)| ((command & 0b01000000)>>2);
	
	CS_Port &= ~(1<< CS_Pin);
	WR_Port &= ~(1<< WR_Pin);
	
	asm volatile ("nop");
	asm volatile ("nop");
	asm volatile ("nop");
	asm volatile ("nop");
	
	WR_Port |= (1<< WR_Pin);
	CS_Port |= (1<< CS_Pin);
}


void GLCD_Send_Data(char data)
{
	RS_Port |= (1<< RS_Pin);			//	Control
	WR_Port |= (1<< WR_Pin);
	RD_Port |= (1<< RD_Pin);
	
	Data_Port = (data & 0x9F);
	Data_Port_1= (data & 0b00100000)| ((data & 0b01000000)>>2);
	
	CS_Port &= ~(1<< CS_Pin);
	WR_Port &= ~(1<< WR_Pin);
	
	asm volatile ("nop");
	asm volatile ("nop");
	asm volatile ("nop");
	asm volatile ("nop");
	
	WR_Port |= (1<< WR_Pin);
	CS_Port |= (1<< CS_Pin);
}
void GLCD_ClearScreen()
{
	uint16_t i, j;
	for(i=0;i<8;i++)
	{
		GLCD_Send_Command(0xb0 | i);	// select page 0~7
		GLCD_Send_Command(0x10);	    // start form column 4
		GLCD_Send_Command(0x00);	    // (2byte command)
		for(j=0;j<128;j++)
		{
			GLCD_Send_Data(0x00);
		}
	}
}


void GLCD_goto(unsigned char page,unsigned char col)
{
	GLCD_Send_Command(0xb0|page); //page 0
	GLCD_Send_Command(0x10 | (col >> 4) );	    // start form column 4
	GLCD_Send_Command(0x00 | (col& 0x0F) );	    // (2byte command)
}


void WritePattern(const char pattern[], char height, char breadth, bool invert)
{
	uint16_t i, j;
	for(i=0;i<height;i++)
	{
		GLCD_Send_Command(0xb0 | i);	// select page 0~7
		GLCD_Send_Command(0x10);	    // start form column 4
		GLCD_Send_Command(0x00);	    // (2byte command)
		for(j=0;j<breadth;j++)
		{
			if (invert==true)
			{
				GLCD_Send_Data(~pgm_read_byte(&pattern[breadth*i+j]));
			}
			else
			{
				GLCD_Send_Data(pgm_read_byte(&pattern[breadth*i+j]));
			}
		}
	}
}


void WriteString(char string[], char length, char page, char column, bool invert , bool para)
{
	GLCD_goto(page,column);	
	char given_column = column;
	for (char x = 0;x<length;x++)
	{	
		if (column>=120)
		{
			page++;
			if (para == false)
			{
				column=0;
			} 
			else
			{
				column = given_column;
			}
			GLCD_goto(page,column);
		}
		
		for (char y = 0;y<7;y++)
		{
			if ((pgm_read_byte(&Font[(string[x]-0x20)*7 + y]) != 0x00) | (string[x]== 0x20))
			{
				if (invert==true)
				{
					GLCD_Send_Data(~pgm_read_byte(&Font[(string[x]-0x20)*7 + y]));
				}
				else
				{
					GLCD_Send_Data(pgm_read_byte(&Font[(string[x]-0x20)*7 + y]));
				}
				column++;
			} 
			else
			{
				break;
			}
		}
		if (invert==true)
		{
			GLCD_Send_Data(0xFF);
			column++;
		}
		else
		{
			GLCD_Send_Data(0x00);
			column++;
		}
	}
}

void Write2XString( char string[], char length, char page, char column, bool invert, bool para)
{
	char Double_Font[28];
	
	/*
		1st 14:	1st page
		2nd 14:	2nd page
	*/
	
	char Y, Given_column;
	Given_column= column;
	
	for (char X=0;X<length;X++)
	{
		if (column>=114)
		{
			page+=2;
			if (para == false)
			{
				column=0;
			}
			else
			{
				column = Given_column;
			}
		}
		for (Y = 0;Y<28;Y++)
		{
			Double_Font[Y]=0x00;
		}
			
		for (Y =0; Y<7; Y++)
		{
			Double_Font[2*Y] = pgm_read_byte(&Font[(string[X]-0x20)*7 + Y]);
			Double_Font[2*Y+1] = pgm_read_byte(&Font[(string[X]-0x20)*7 + Y]);
		}
		
		for (Y =0; Y<14; Y++)
		{
			Double_Font[14+Y] = ((Double_Font[Y] & 0b10000000)) | ((Double_Font[Y] & 0b10000000)>>1) |  ((Double_Font[Y] & 0b01000000)>>1) | ((Double_Font[Y] & 0b01000000)>>2) |  ((Double_Font[Y] & 0b00100000)>>2) | ((Double_Font[Y] & 0b00100000)>>3) |  ((Double_Font[Y] & 0b00010000)>>3) | ((Double_Font[Y] & 0b00010000)>>4);
			Double_Font[Y] = ((Double_Font[Y] & 0b00001000))<<4 | ((Double_Font[Y] & 0b00001000)<<3) |  ((Double_Font[Y] & 0b00000100)<<3) | ((Double_Font[Y] & 0b00000100)<<2) |  ((Double_Font[Y] & 0b00000010)<<2) | ((Double_Font[Y] & 0b00000010)<<1) |  ((Double_Font[Y] & 0b00000001)<<1) | ((Double_Font[Y] & 0b00000001));
		}
	
		for (Y =0; Y<14; Y++)
		{
				GLCD_Send_Command(0xb0 | page);					// select page 0~7
				GLCD_Send_Command(0x10 | (column >> 4) );	    // start form column 4
				GLCD_Send_Command(0x00 | (column & 0x0F));	    // (2byte command)
				
				if ((!((Double_Font[Y] == 0x00)&(Double_Font[14+Y] == 0x00)))| (string[X]== 0x20))
				{
					if (invert==true)
					{
						GLCD_Send_Data(~Double_Font[Y]);
					}
					else
					{
						GLCD_Send_Data(Double_Font[Y]);
					}
					
					
					/////////////////////////////	1st Line	//////////////////////////////////////////
					
					GLCD_Send_Command(0xb0 | (page+1));					// select page 0~7
					GLCD_Send_Command(0x10 | (column >> 4) );	    // start form column 4
					GLCD_Send_Command(0x00 | (column & 0x0F));	    // (2byte command)
					
					
					if (invert==true)
					{
						GLCD_Send_Data(~Double_Font[14+Y]);
					}
					else
					{
						GLCD_Send_Data(Double_Font[14+Y]);
					}
					column++;
				} 
				else
				{
					break;
				}
		}
		
		if (invert==true)
		{
			GLCD_Send_Command(0xb0 | page);					// select page 0~7
			GLCD_Send_Command(0x10 | (column >> 4) );	    // start form column 4
			GLCD_Send_Command(0x00 | (column & 0x0F));	    // (2byte command)
			GLCD_Send_Data(0xFF);
			
			GLCD_Send_Command(0xb0 | (page+1));					// select page 0~7
			GLCD_Send_Command(0x10 | (column >> 4) );	    // start form column 4
			GLCD_Send_Command(0x00 | (column & 0x0F));	    // (2byte command)
			GLCD_Send_Data(0xFF);
			column++;
		}
		else
		{
			GLCD_Send_Command(0xb0 | page);					// select page 0~7
			GLCD_Send_Command(0x10 | (column >> 4) );	    // start form column 4
			GLCD_Send_Command(0x00 | (column & 0x0F));	    // (2byte command)
			GLCD_Send_Data(0x00);
			
			GLCD_Send_Command(0xb0 | (page+1));					// select page 0~7
			GLCD_Send_Command(0x10 | (column >> 4) );	    // start form column 4
			GLCD_Send_Command(0x00 | (column & 0x0F));	    // (2byte command)
			GLCD_Send_Data(0x00);
			column++;
		}
	}
}

#endif /* GLCD_H_ */